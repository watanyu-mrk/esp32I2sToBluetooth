## esp32cam_i2s_a2dp/main/Kconfig.projbuild
```kconfig
menu "ESP32-CAM I2S to A2DP bridge"

config APP_BT_DEVICE_NAME
    string "Local Bluetooth name"
    default "ESP32-CAM-A2DP"
    help
        Name advertised by the ESP32-CAM over Bluetooth Classic.

config APP_BT_TARGET_NAME
    string "Bluetooth speaker name to connect to"
    default "BT-Speaker"
    help
        The A2DP source connects to the first discovered device whose name
        starts with this string. Leave empty to connect to the first
        discoverable A2DP sink.

config APP_BT_SSP
    bool "Use Secure Simple Pairing (SSP)"
    default n
    help
        Enable Bluetooth Secure Simple Pairing for speakers that reject the
        legacy PIN handshake. The ESP32-CAM has no display and no keypad, so
        the numeric comparison value is accepted automatically (Just Works /
        auto-confirm) and passkey notifications are only logged.

        Leave this off for older speakers that only support legacy pairing
        with a PIN code.

choice APP_OUTPUT_RATE
    prompt "A2DP sample rate (PCM sent to the speaker)"
    default APP_OUTPUT_RATE_44100

    config APP_OUTPUT_RATE_44100
        bool "44100 Hz"
    config APP_OUTPUT_RATE_48000
        bool "48000 Hz"
endchoice

choice APP_INPUT_RATE
    prompt "I2S input sample rate (what the ESP32-S3 sends)"
    default APP_INPUT_RATE_44100
    help
        I2S runs as a slave, so this value is not used to generate a clock.
        It only describes the incoming rate: when it differs from the A2DP
        sample rate the PCM is resampled (linear interpolation) before it
        is queued for Bluetooth.

    config APP_INPUT_RATE_44100
        bool "44100 Hz"
    config APP_INPUT_RATE_48000
        bool "48000 Hz"
endchoice

config APP_I2S_BCLK_GPIO
    int "I2S BCLK GPIO (input)"
    default 14
    range 0 39

config APP_I2S_WS_GPIO
    int "I2S WS/LRCK GPIO (input)"
    default 13
    range 0 39

config APP_I2S_DATA_GPIO
    int "I2S DATA GPIO (input)"
    default 4
    range 0 39
    help
        GPIO4 also drives the ESP32-CAM flash LED, so the LED may glow
        faintly while audio is being received.

config APP_I2S_PCM_SHIFT_BITS
    int "Right shift applied to each 32-bit I2S slot to obtain PCM16"
    default 16
    range 0 16
    help
        16 assumes the 16-bit PCM is left aligned in the 32-bit slot
        (upper half), which is what ESP32-audioI2S produces with 32-bit
        slots. Use 0 if the data turns out to be right aligned.

config APP_AUDIO_BUFFER_MS
    int "Audio buffer size (ms)"
    default 300
    range 50 2000
    help
        Jitter buffer between the I2S receiver and the A2DP data callback.
        Larger values survive longer I2S/BT hiccups but add latency.

config APP_PIN_CHECK
    bool "Check that BCLK/WS/DATA are toggling at boot"
    default y
    help
        Runs after boot, before the I2S receiver starts: the three input
        pins are sampled as plain GPIOs for a moment and each line is logged
        as toggling, static HIGH or static LOW. A silent BCLK means the
        ESP32-S3 is not clocking the bus (or a wire is missing), which
        otherwise only shows up as an endless stream of I2S read timeouts.

        Not used in test tone mode (CONFIG_APP_TEST_TONE), where the I2S
        input is ignored anyway.

config APP_PIN_CHECK_WINDOW_MS
    int "GPIO activity sampling window (ms)"
    default 60
    range 10 500
    depends on APP_PIN_CHECK
    help
        How long each pin is watched. Longer windows catch a clock that
        starts late, and give slow lines like WS more edges to count.

config APP_LOOPBACK_TEST
    bool "Run an I2S loopback self test at boot"
    default n
    help
        Uses I2S1 as a master transmitter on the same BCLK/WS/DATA pins the
        receiver listens on (internal GPIO loopback, no wiring needed), then
        verifies the frames that reach the audio buffer: 32-bit slot
        conversion, stereo order and the configured shift. Runs once, logs
        PASS/FAIL, and does not require Bluetooth or the ESP32-S3.

        The loopback master drives the same pins, so run it with the
        ESP32-S3 disconnected to avoid two drivers on one bus.

config APP_TEST_TONE
    bool "Use a generated 1 kHz test tone instead of the I2S input"
    default n
    help
        Lets you verify the Bluetooth path without the ESP32-S3 connected.

config APP_PORTAL_DELAY_S
    int "Start the Wi-Fi config portal after this many seconds without a speaker"
    default 180
    range 10 3600
    help
        The board boots straight into Bluetooth and never raises the Wi-Fi
        config portal while it is still trying to reach a speaker: Wi-Fi and
        Bluetooth Classic share the radio and the heap. Only after this long
        without a connected speaker does it shut the Bluetooth stack down
        (releasing its memory to the Wi-Fi stack) and start the access point.

        Bluetooth cannot be started again in that boot, so the portal stays up
        until the settings are saved (which reboots the board) or the board is
        restarted.

config APP_STATS_INTERVAL_MS
    int "Status log interval (ms)"
    default 5000
    range 1000 60000

endmenu
```

## esp32radio_a2dp/main/Kconfig.projbuild
```kconfig
menu "ESP32 Internet radio to A2DP source"

config APP_STATION_URL
    string "Radio station stream URL (factory default)"
    default "https://coolism-web.cdn.byteark.com/;stream/1"
    help
        Direct MP3 stream URL (http:// or https://). Playlists, HLS and AAC
        streams are not supported.

        This is only the factory default: the URL can be changed at runtime
        from the web page stored in NVS, which overrides this value.

config APP_STATION_NAME
    string "Station name shown on the web page"
    default "COOLfahrenheit"
    help
        Free text, used for logging and in the config page header.

config APP_WIFI_SSID
    string "Wi-Fi network to join (factory default)"
    default ""
    help
        SSID of the access point the board uses to reach the station. Leave
        empty to boot straight into the setup access point.

        This is only the factory default: the network can be changed at
        runtime from the config web page.

config APP_WIFI_PASSWORD
    string "Wi-Fi password (factory default)"
    default ""

config APP_WIFI_JOIN_TIMEOUT_S
    int "Raise the setup access point after this many seconds without Wi-Fi"
    default 25
    range 5 300
    help
        While the board cannot join the configured network the config page is
        unreachable, so after this long the board also starts its own access
        point (SSID ESP32-Radio-Setup) and keeps retrying the configured
        network in the background.

config APP_AUDIO_BUFFER_MS
    int "Jitter buffer size (ms)"
    default 1000
    range 200 3000
    help
        Decoded PCM kept between the MP3 decoder and the Bluetooth stack.
        Internet streams arrive in bursts and the Wi-Fi/Bluetooth radio
        sharing adds gaps, so this buffer is what keeps the audio continuous.
        Larger values survive longer dropouts but delay the audio.

config APP_BT_DEVICE_NAME
    string "Local Bluetooth name"
    default "ESP32-Radio-A2DP"
    help
        Name advertised by this board over Bluetooth Classic.

config APP_BT_TARGET_NAME
    string "Bluetooth speaker name to connect to"
    default ""
    help
        The A2DP source connects to the first discovered device whose name
        starts with this string. Leave empty to connect to the first
        discoverable A2DP sink.

config APP_BT_PIN_CODE
    string "Legacy pairing PIN code (1-16 digits)"
    default "1234"
    help
        PIN code this board answers with when the sink asks for a legacy
        pairing code. Many car head units expect "0000".

        Only the factory default: the value can be changed at runtime from
        the web page. Leave empty to keep the A2DP library default.

config APP_INITIAL_VOLUME
    int "Volume set when the speaker starts playing (0-127)"
    default 60
    range 0 127
    help
        A2DP volume pushed to the speaker as soon as the audio stream starts.
        Speakers come back at their own (usually maximum) level on every power
        cycle, which is what this value exists to stop.

        127 is the maximum, 0 is silent. Only the factory default: the level
        can be changed at runtime from the web page.

config APP_BT_SSP
    bool "Use Secure Simple Pairing (SSP)"
    default n
    help
        Enable Bluetooth Secure Simple Pairing for speakers that reject the
        legacy PIN handshake. This board has no display and no keypad, so the
        numeric comparison value is accepted automatically.

        Leave this off for older speakers that only support legacy pairing.

config APP_STATS_INTERVAL_MS
    int "Status log interval (ms)"
    default 5000
    range 1000 60000

endmenu
```
